/* See LICENSE for license details. */

OUTPUT_ARCH( "riscv" )

ENTRY( init_early )

SECTIONS
{

  /*--------------------------------------------------------------------*/
  /* Memory
  /*--------------------------------------------------------------------*/

  . = 0x80000000;
  .boot1.code :
  {
    *(.boot1.code)
  }
  . = 0x80000f00;
  .restore.flag :
  {
    *(.restore.flag)
  }
  . = 0x80001000;
  .restore.data :
  {
    *(.restore.data)
  }
  . = 0x80010000;
  .boot2.code :
  {
    *(.boot2.code)
  }
  
  /*--------------------------------------------------------------------*/
  /* Device
  /*--------------------------------------------------------------------*/
  . = 0x80080000;

  stack0 = 0x800ee000;
}