/* See LICENSE for license details. */

OUTPUT_ARCH( "riscv" )

ENTRY( init_early )

SECTIONS
{

  /*--------------------------------------------------------------------*/
  /* Memory
  /*--------------------------------------------------------------------*/

  . = 0x00000000;
  .boot1.code :
  {
    *(.boot1.code)
  }
  . = 0x00000f00;
  .restore.flag :
  {
    *(.restore.flag)
  }
  . = 0x00001000;
  .restore.data :
  {
    *(.restore.data)
  }
  . = 0x00010000;
  .boot2.code :
  {
    *(.boot2.code)
  }
  
  /*--------------------------------------------------------------------*/
  /* Device
  /*--------------------------------------------------------------------*/
  . = 0x00080000;

  stack0 = 0x000ee000;
}
